## conf/layer.conf
```bitbake
# We have a conf and classes directory, add to BBPATH
BBPATH .= ":${LAYERDIR}"

# We have recipes-* directories, add to BBFILES BBFILES +=
BBFILES += " \
	${LAYERDIR}/recipes-*/*.bb \
	${LAYERDIR}/recipes-*/*.bbappend \
	${LAYERDIR}/recipes-*/*/*.bb \
	${LAYERDIR}/recipes-*/*/*.bbappend \
"

BBFILE_COLLECTIONS += "mi"
BBFILE_PATTERN_mi = "^${LAYERDIR}/"
BBFILE_PRIORITY_mi = "7"
LAYERSERIES_COMPAT_mi = "dunfell"

#LAYERDEPENDS_mi = "core yocto yoctobsp openembedded-layer meta-python"
```
